## boards/mips/pic32mx/p32mx270f256b_bare/Kconfig
```kconfig
#
# For a description of the syntax of this configuration file,
# see the file kconfig-language.txt in the NuttX tools repository.
#

if ARCH_BOARD_P32MX270F256B_BARE

config P32MX270F256B_BARE_RELEASE
	int "Mirtoo release number"
	default 2
	---help---
		Select the Mirtoo release number.  For example, 1 for release R1.

endif
```
